// This file was generated from a template. Edit it to match your keyboard.
// See https://zmk.dev/docs/development/hardware-integration/new-shield for more
// instructions.

#include "dactyl_alfgar.dtsi"

&kscan {
    // Replace these comments with the GPIO pins in the matrix for the left side.
    // See https://zmk.dev/docs/development/hardware-integration/new-shield#shield-overlays
    col-gpios
        = <&pro_micro 4 GPIO_ACTIVE_HIGH> // col1 in the schematic
        , <&pro_micro 5 GPIO_ACTIVE_HIGH> // col2 in the schematic
        , <&pro_micro 6 GPIO_ACTIVE_HIGH> // col3 in the schematic
        , <&pro_micro 7 GPIO_ACTIVE_HIGH> // col4 in the schematic
        , <&pro_micro 8 GPIO_ACTIVE_HIGH> // col5 in the schematic
        , <&pro_micro 9 GPIO_ACTIVE_HIGH> // col6 in the schematic       
        ;
};
