## boards/shields/dactyl_alfgar/Kconfig.defconfig
```kconfig
if SHIELD_DACTYL_ALFGAR_LEFT

config ZMK_KEYBOARD_NAME
    default "Dactyl Alfgar"

config ZMK_SPLIT_ROLE_CENTRAL
    default y

endif # SHIELD_DACTYL_ALFGAR_LEFT

if SHIELD_DACTYL_ALFGAR_LEFT || SHIELD_DACTYL_ALFGAR_RIGHT

config ZMK_SPLIT
    default y

endif # SHIELD_DACTYL_ALFGAR_LEFT || SHIELD_DACTYL_ALFGAR_RIGHT
```

## boards/shields/dactyl_alfgar/Kconfig.shield
```kconfig
config SHIELD_DACTYL_ALFGAR_LEFT
    def_bool $(shields_list_contains,dactyl_alfgar_left)

config SHIELD_DACTYL_ALFGAR_RIGHT
    def_bool $(shields_list_contains,dactyl_alfgar_right)
```
